## dts/bindings/dac/adi,ad524x-base.yaml
```yaml
# Copyright (c) 2026 Analog Devices Inc.
# SPDX-License-Identifier: Apache-2.0

# Common fields for the AD524x family of dual-channel, 256-position I2C digital
# potentiometers (AD5243, AD5248).

include: [dac-controller.yaml, i2c-device.yaml]

properties:
  "#io-channel-cells":
    const: 1

  max-resistance:
    type: int
    required: true
    enum:
      - 2500
      - 10000
      - 50000
      - 100000
    default: 10000
    description: |
      End-to-end (R_AB) nominal resistance of the device variant, in ohms.
      Select the value matching the ordered part number. The
      AD524X_RESISTANCE_* macros in
      <zephyr/dt-bindings/dac/ad524x.h> provide named constants:
      - 2500   (2.5 kOhm) / AD524X_RESISTANCE_2K5
      - 10000  (10 kOhm)  / AD524X_RESISTANCE_10K
      - 50000  (50 kOhm)  / AD524X_RESISTANCE_50K
      - 100000 (100 kOhm) / AD524X_RESISTANCE_100K

      The default setting is 10kOhm.

  channel-1-initial-resistance:
    type: int
    default: 320
    description: |
      Initial wiper-to-terminal-B resistance of channel 1, in ohms, applied
      during channel setup. The minimum is the fixed wiper resistance
      (320 ohms); the maximum is the device end-to-end resistance.

      The default setting is 320Ohms.

  channel-2-initial-resistance:
    type: int
    default: 320
    description: |
      Initial wiper-to-terminal-B resistance of channel 2, in ohms, applied
      during channel setup. The minimum is the fixed wiper resistance
      (320 ohms); the maximum is the device end-to-end resistance.

      The default setting is 320Ohms.

io-channel-cells:
  - output
```

## dts/bindings/mfd/adi,max2035x-common.yaml
```yaml
# Copyright (c) 2026 Analog Devices, Inc.
# SPDX-License-Identifier: Apache-2.0

description: |
  Common properties for the Analog Devices MAX20356/MAX20358 wearable PMIC.

  This binding is included by the variant-specific bindings
  (adi,max20356.yaml and adi,max20358.yaml). The variant is selected solely by
  the parent node's compatible string; there is no runtime part-ID.

  Subsystems are exposed as child nodes (regulator, charger, gpio, watchdog),
  each with its own compatible. The integrated fuel gauge is NOT a child of this
  node: describe it as a separate top-level "maxim,max17262" node at its own I2C
  address.

include: i2c-device.yaml

properties:
  reg:
    required: true

  int-gpios:
    type: phandle-array
    description: |
      Host GPIO connected to the PMIC INTB pin (open-drain, active-low). When
      present, the driver uses INTB as an interrupt trigger source: it decodes
      the pending Int0-5/Status0-4 sources and dispatches registered callbacks.
      When absent, the driver operates in a poll-only fallback.

  spi-dvs:
    type: phandle
    description: |
      SPI controller wired to MPC0/MPC1/MPC2 (CS/SCLK/DIN) for SPI dynamic
      voltage scaling (DVS Mode 2). Required only when a buck child selects
      adi,dvs-mode = "spi".

  adi,intb-unmasked-in-shutdown:
    type: boolean
    description: |
      Leave INTB unmasked during shutdown (PwrCfg.INTBootMsk = 1). When absent
      INTB is masked during shutdown (OTP default), which prevents the INTB line
      from locking up the application processor while the PMIC powers down.

  adi,stay-on:
    type: boolean
    description: |
      Set PwrCfg.StayOn at init to keep the part powered on (StayOn = 1). The
      hardware requires this within 5s of power-on or it shuts down and returns
      to the power-off condition; the bit has no effect once already set. Only
      set this when the driver, rather than the application, owns the keep-alive
      handshake.

  adi,active-discharge-constant:
    type: boolean
    description: |
      Discharge a disabled block's output constantly rather than for 50ms
      (MiscFunctions.MiscFunc[0] = 1). When absent the OTP default (50ms pulse)
      is kept. Only applies to blocks that have active discharge enabled.

  adi,rtc-ldo-off:
    type: boolean
    description: |
      Turn the RTC-LDO feature off (MiscFunctions.MiscFunc[1] = 1). When absent
      the OTP default (RTC-LDO on) is kept.

  adi,factory-mode-disabled:
    type: boolean
    description: |
      Disable factory mode (MiscFunctions.MiscFunc[2] = 1). When absent the OTP
      default (factory mode enabled) is kept.
```

## dts/bindings/regulator/adi,max20356-regulator.yaml
```yaml
# Copyright (c) 2026 Analog Devices, Inc.
# SPDX-License-Identifier: Apache-2.0

description: |
  Analog Devices MAX20356/MAX20358 PMIC regulators.

  The regulators node is a child of the MAX20356 MFD parent. Each rail is a
  child node whose node name selects the rail; the driver strictly matches these
  names: BUCK1, BUCK2, BUCK3, BUCKBOOST, LDO1, LDO2, LDO3, LDO4, LSW1, LSW2,
  LSW3.

  Bucks support dynamic voltage scaling (DVS): I2C (Mode 0, default), GPIO
  (Mode 1, an MPC-pin pair selects one of four preset voltages) and SPI (Mode 2,
  MPC0/1/2 driven by the controller referenced by the parent's spi-dvs phandle).
  The buck-boost and LDOs do not participate in MPC/SPI DVS.

  LDO1 and LDO2 can operate as a linear regulator or a load switch, selected via
  regulator-initial-mode using the MAX20356_MODE_* macros from
  <zephyr/dt-bindings/mfd/max20356.h>.

compatible: "adi,max20356-regulator"

include: base.yaml

child-binding:
  include:
    - name: regulator.yaml
      property-allowlist:
        - regulator-min-microvolt
        - regulator-max-microvolt
        - regulator-init-microvolt
        - regulator-always-on
        - regulator-boot-on
        - regulator-initial-mode
        - regulator-allowed-modes
        - regulator-active-discharge

  properties:
    adi,buck-voltage-step-microvolt:
      type: int
      default: 50000
      enum:
        - 10000
        - 25000
        - 50000
      description: |
        Buck rail voltage step (Buck<n>VStep). Selects the buck output scale:
        0.500-1.130V at 10mV, 0.500-2.075V at 25mV, or 0.500-3.650V at 50mV,
        all from a 0.5V base (Buck<n>VSet[5:0]). Ignored for non-buck rails.

    adi,dvs-mode:
      type: string
      default: "i2c"
      enum:
        - "i2c"
        - "gpio"
        - "spi"
      description: |
        Dynamic voltage scaling mode for a buck rail (Buck<n>DvsCfg). "i2c"
        drives the voltage over the I2C bus; "gpio" selects one of four preset
        voltages from an MPC-pin pair (see adi,dvs-mpc-pair and adi,dvs-voltages);
        "spi" repurposes MPC0/1/2 as an SPI DVS interface (requires the parent's
        spi-dvs phandle). Ignored for the buck-boost, LDOs and load switches.

    adi,dvs-mpc-pair:
      type: array
      description: |
        For adi,dvs-mode = "gpio": the ordered MPC-pin pair (two entries, each
        0..7) that selects the active DVS voltage. The first entry is the low
        select bit, the second the high select bit, per the datasheet decode
        table. These pins must not also be claimed by the GPIO child.

    adi,dvs-voltages:
      type: array
      description: |
        For adi,dvs-mode = "gpio": the four alternate output voltages in
        microvolts (Buck<n>DvsVlt0..3) corresponding to MPC select states
        00/01/10/11. Each value must lie within the rail's configured range.

    adi,dvs-valley-current-microamp:
      type: int
      default: 500000
      enum:
        - 500000
        - 1000000
      description: |
        DVS valley (inductor) current limit (Buck<n>DvsCfg0.Buck<n>DvsCur).

    adi,dvs-spi:
      type: phandle
      description: |
        For adi,dvs-mode = "spi": the SPI device (on a controller wired to
        MPC0/1/2) used to clock DVS command bytes to this buck. The command byte
        is {AD[1:0], VLT[5:0]} where AD selects the buck (0=buck1, 1=buck2,
        2=buck3).

    adi,ldo4-always-on-off-on-pfn1:
      type: boolean
      description: |
        LDO4 only, MAX20358 variant only: enable "Always-On LDO Off Through PFN1"
        (LDO4Cfg.LDO4RTC, 0x67 bit 7). On the MAX20356 this request is rejected
        with -ENOTSUP and the bit is left cleared.
```

## dts/bindings/watchdog/adi,max20356-watchdog.yaml
```yaml
# Copyright (c) 2026 Analog Devices, Inc.
# SPDX-License-Identifier: Apache-2.0

description: |
  Analog Devices MAX20356/MAX20358 PMIC watchdog.

  Child node of the MAX20356 MFD parent. Exposes the standard Zephyr watchdog
  API; the timeout window and reset behavior are set at runtime through the wdt
  API, so no special devicetree properties are required.

  The watchdog is fed by reading the shared Int5 register, so it must own the
  parent's INTB path exclusively: it cannot be armed while any INTB event consumer
  is active, and no consumer can register an interrupt callback while it is armed.
  Registration is refused with -EBUSY in either direction.

  The charger registers its INTB callbacks lazily, only while a status or online
  notifier is installed, so a poll-only charger (no notifier) leaves INTB free and
  can share a parent with the watchdog. A charger using notifications, or any
  other active INTB consumer, must be placed under a separate
  MAX20356/MAX20358 instance from the watchdog.

compatible: "adi,max20356-watchdog"

include: base.yaml
```
