## drivers/dac/Kconfig.ad524x
```kconfig
# AD5243/AD5248 Digital Potentiometer configuration options

# Copyright (c) 2026 Analog Devices Inc.
# SPDX-License-Identifier: Apache-2.0

config DAC_AD524X
	bool "Analog Devices AD5243/AD5248 DAC driver"
	default y
	select I2C
	depends on DT_HAS_ADI_AD5243_ENABLED \
		|| DT_HAS_ADI_AD5248_ENABLED
	help
	  Enable the driver for the Analog Devices AD5243/AD5248 Digital Potentiometer.

if DAC_AD524X

config DAC_AD524X_INIT_PRIORITY
	int "Init priority"
	default 80
	help
	  Analog Devices AD5243/AD5248 DAC device driver initialization priority.

endif # DAC_AD524X
```

## drivers/mfd/Kconfig.max20356
```kconfig
# Copyright (c) 2026 Analog Devices, Inc.
# SPDX-License-Identifier: Apache-2.0

config MFD_MAX20356
	bool "MAX20356/MAX20358 PMIC multi-function device driver"
	default y
	depends on DT_HAS_ADI_MAX20356_ENABLED || DT_HAS_ADI_MAX20358_ENABLED
	select I2C
	help
	  Enable the Analog Devices MAX20356/MAX20358 wearable PMIC
	  multi-function device driver. This parent driver provides the shared
	  I2C register access, variant selection, power-mode/reset commands and
	  monitor-mux control used by the regulator, charger, GPIO and watchdog
	  child drivers.

config MFD_MAX20356_TRIGGER
	bool "MAX20356/MAX20358 INTB trigger support"
	default y
	depends on MFD_MAX20356
	depends on GPIO
	depends on $(dt_compat_any_has_prop,$(DT_COMPAT_ADI_MAX20356),int-gpios) || \
		$(dt_compat_any_has_prop,$(DT_COMPAT_ADI_MAX20358),int-gpios)
	help
	  Enable INTB interrupt handling for the MAX20356/MAX20358 PMIC. The
	  parent installs a GPIO callback on the INTB line, decodes the pending
	  Int0-5 sources in a workqueue, and dispatches them to consumers that
	  registered through mfd_max20356_add_callback(). Without this option the
	  driver operates poll-only and the callback API returns -ENOTSUP.

if MFD_MAX20356_TRIGGER

choice MAX20356_TRIGGER_MODE
	prompt "MAX20356/MAX20358 INTB trigger mode"
	default MAX20356_TRIGGER_GLOBAL_THREAD
	help
	  Select the context in which INTB source decode runs. Decode needs I2C
	  transactions, so it never runs in the GPIO ISR; the ISR only schedules
	  the selected bottom half.

config MAX20356_TRIGGER_GLOBAL_THREAD
	bool "Use global thread"
	help
	  Dispatch INTB handling to the system workqueue.

config MAX20356_TRIGGER_OWN_THREAD
	bool "Use own thread"
	help
	  Dispatch INTB handling to a dedicated driver thread.

endchoice # MAX20356_TRIGGER_MODE

config MAX20356_THREAD_PRIORITY
	int "INTB own-thread priority"
	depends on MAX20356_TRIGGER_OWN_THREAD
	default 10
	help
	  Cooperative priority of the dedicated INTB handling thread.

config MAX20356_THREAD_STACK_SIZE
	int "INTB own-thread stack size"
	depends on MAX20356_TRIGGER_OWN_THREAD
	default 1024
	help
	  Stack size (bytes) of the dedicated INTB handling thread. Size it for
	  the registered callbacks, which run in this thread's context.

endif # MFD_MAX20356_TRIGGER

config EMUL_MAX20356
	bool "MAX20356/MAX20358 PMIC emulator"
	default y
	depends on EMUL
	depends on MFD_MAX20356
	help
	  Enable the register-model I2C emulator for the MAX20356/MAX20358 PMIC.
	  Backs the MFD parent's register accesses with an in-memory register
	  file so the driver and its children can be tested without hardware.
	  Read-only registers present a constant value on the I2C read path.
```

## drivers/regulator/Kconfig.max20356
```kconfig
# Copyright (c) 2026 Analog Devices, Inc.
# SPDX-License-Identifier: Apache-2.0

config REGULATOR_MAX20356
	bool "MAX20356/MAX20358 PMIC regulator driver"
	default y
	depends on DT_HAS_ADI_MAX20356_REGULATOR_ENABLED
	depends on MFD_MAX20356
	help
	  Enable the Analog Devices MAX20356/MAX20358 PMIC regulator driver.
	  Each rail (buck1-3, buck-boost, ldo1-4, lsw1-3) is a devicetree child
	  node driven through the MAX20356 MFD parent.

if REGULATOR_MAX20356

config REGULATOR_MAX20356_COMMON_INIT_PRIORITY
	int "MAX20356 regulator driver init priority (common part)"
	default 86
	help
	  Init priority for the MAX20356/MAX20358 regulator driver (common
	  part). It must be greater than the MFD parent init priority.

config REGULATOR_MAX20356_INIT_PRIORITY
	int "MAX20356 regulator driver init priority"
	default 87
	help
	  Init priority for the MAX20356/MAX20358 regulator rails. It must be
	  greater than REGULATOR_MAX20356_COMMON_INIT_PRIORITY.

endif # REGULATOR_MAX20356
```

## dts/bindings/charger/adi,max20356-charger.yaml
```yaml
# Copyright (c) 2026 Analog Devices, Inc.
# SPDX-License-Identifier: Apache-2.0

description: |
  Analog Devices MAX20356/MAX20358 PMIC battery charger.

  Child node of the MAX20356 MFD parent. Exposes the standard Zephyr charger API
  (enable/disable, fast-charge current, battery regulation voltage, status,
  health and online reporting). JEITA thermal configuration is applied at init
  from the properties below; runtime zone changes are hardware-managed and
  reported through the charger health/status properties.

  Status/online reporting works poll-only and uses no interrupt. The optional
  status and online notifier callbacks are interrupt-driven: installing one makes
  the charger claim its INTB event groups on the parent, and clearing it releases
  them. This shares the parent's INTB path with the watchdog, which requires
  exclusive INTB ownership: while a notifier is installed the watchdog cannot arm,
  and while the watchdog is armed installing a notifier is refused with -EBUSY.
  To use both on one parent, keep the charger poll-only (install no notifier);
  otherwise place the watchdog under a separate MAX20356/MAX20358 instance.

compatible: "adi,max20356-charger"

include: battery.yaml

properties:
  constant-charge-current-microamp:
    type: int
    description: |
      Fast-charge (CC) current in microamps (ChgCur0.CC1IFChg), 4000..500000.
      Values outside the supported range are rejected at runtime.

  constant-charge-voltage-microvolt:
    type: int
    description: |
      Battery regulation (charge-termination) voltage in microvolts
      (ChgCntl1.ChgBatReg).

  # --- Init-time configuration for registers 0x18..0x28 -----------------------
  # Each property below is applied to hardware only when it is present in the
  # node; a property left unset keeps the chip's OTP power-on default. Values
  # given as enum lists are ordered to match the raw register field encoding.

  # CHGCUR1 @ 0x18
  adi,cc2-charge-current-microamp:
    type: int
    description: |
      Fast-charge constant-current zone 2 (CC2) current in microamps
      (ChgCur1.CC2IFChg), 4000..500000. Same encoding as the CC1 current.
      Values outside the supported range are rejected at init.

  # CHGCNTL0 @ 0x19 (ChgEn is controlled at runtime via charge_enable())
  adi,charge-autostop:
    type: boolean
    description: Enable charger autostop (ChgCntl0.ChgAutoStop).

  adi,charge-auto-restart:
    type: boolean
    description: |
      Automatically restart charging when VBAT drops below the recharge
      threshold (ChgCntl0.ChgAutoReSta).

  adi,force-recharge-monitor:
    type: boolean
    description: |
      Keep the recharge-battery monitor comparator enabled even when the
      charger is disabled (ChgCntl0.FrcRchgMonEn).

  adi,cc1-room-only:
    type: boolean
    description: Run CC1 fast charge in the room temperature zone only
      (ChgCntl0.CC1RoomOnly).

  adi,cc1-timer-limit:
    type: boolean
    description: |
      Run the CC1 fast-charge phase with the CC1FChgTmr limit
      (ChgCntl0.CC1TmoLimit).

  adi,cc1-enable:
    type: boolean
    description: |
      Enable the CC1 (step) charging phase (ChgCntl0.CC1Enable). When unset the
      charger runs in CC2 only and step charging is disabled.

  # CHGCNTL1 @ 0x1A (ChgBatReg is set via constant-charge-voltage-microvolt)
  adi,recharge-threshold-microvolt:
    type: int
    enum: [50000, 100000, 150000, 220000]
    description: |
      Recharge threshold below the battery regulation voltage
      (ChgCntl1.BatReChg), expressed as the offset in microvolts.

  # CHGCNTL2 @ 0x1B
  adi,precharge-voltage-microvolt:
    type: int
    enum: [2700000, 2800000, 2900000, 3000000, 3100000, 3200000, 3300000, 3400000]
    description: Precharge voltage rising threshold (ChgCntl2.VPChg).

  adi,precharge-current-percent:
    type: int
    enum: [5, 10, 20, 30]
    description: |
      Precharge current as a percentage of the fast-charge current IFCHG
      (ChgCntl2.IPChg): 0.05/0.10/0.20/0.30 x IFCHG.

  adi,charge-done-current-percent:
    type: int
    enum: [2, 5, 10, 20]
    description: |
      Charge-done current threshold as a percentage of IFCHG
      (ChgCntl2.IChgDone). The 2 value corresponds to 0.025 x IFCHG; the
      remaining values are 0.05/0.10/0.20 x IFCHG.

  # CHGTMR @ 0x1C
  adi,maintain-charge-timer-minutes:
    type: int
    enum: [0, 15, 30, 60]
    description: Maintain-charge timer (ChgTmr.MtChgTmr). 0 disables the timer.

  adi,precharge-timer-minutes:
    type: int
    enum: [30, 60, 120, 240]
    description: Precharge safety timer (ChgTmr.PChgTmr).

  adi,cc1-fastcharge-timer-minutes:
    type: int
    enum: [30, 60, 120, 240]
    description: CC1 fast-charge timer (ChgTmr.CC1FChgTmr).

  adi,safety-timer-minutes:
    type: int
    enum: [75, 150, 300, 600]
    description: Charger safety timer covering all charging states (ChgTmr.ChgTmr).

  # CHGCFG0 @ 0x1D
  adi,step-charge-hysteresis-microvolt:
    type: int
    enum: [100000, 200000, 300000, 400000, 500000, 600000]
    description: Step-charge voltage falling hysteresis (ChgCfg0.ChgStepHyst).

  adi,step-charge-rise-microvolt:
    type: int
    enum: [3800000, 3850000, 3900000, 3950000, 4000000, 4050000, 4100000, 4150000,
           4200000, 4250000, 4300000, 4350000, 4400000, 4450000, 4500000, 4550000]
    description: Step-charge voltage rising threshold (ChgCfg0.ChgStepRise).

  # ThmCfg0 @ 0x1E (JEITA cool zone)
  adi,cool-cc1-current-percent:
    type: int
    enum: [20, 30, 40, 50, 60, 70, 80, 100]
    description: |
      Cool-zone CC1 fast-charge current as a percentage of IFCHG
      (ThmCfg0.ChgCoolCC1IFChg).

  adi,cool-batreg-offset-microvolt:
    type: int
    enum: [150000, 100000, 50000, 0]
    description: |
      Cool-zone battery regulation voltage reduction below ChgBatReg
      (ThmCfg0.ChgCoolBatReg), expressed as the offset in microvolts. 0 means
      no reduction. Listed in register-code order.

  adi,cool-cc2-current-percent:
    type: int
    enum: [20, 30, 40, 50, 60, 70, 80, 100]
    description: |
      Cool-zone CC2 fast-charge current as a percentage of IFCHG
      (ThmCfg0.ChgCoolCC2IFChg).

  # ThmCfg1 @ 0x1F (JEITA room zone)
  adi,room-cc1-current-percent:
    type: int
    enum: [20, 30, 40, 50, 60, 70, 80, 100]
    description: Room-zone CC1 current as a percentage of IFCHG
      (ThmCfg1.ChgRoomCC1IFChg).

  adi,room-batreg-offset-microvolt:
    type: int
    enum: [150000, 100000, 50000, 0]
    description: |
      Room-zone battery regulation voltage reduction below ChgBatReg
      (ThmCfg1.ChgRoomBatReg). 0 means no reduction. Register-code order.

  adi,room-cc2-current-percent:
    type: int
    enum: [20, 30, 40, 50, 60, 70, 80, 100]
    description: Room-zone CC2 current as a percentage of IFCHG
      (ThmCfg1.ChgRoomCC2IFChg).

  # ThmCfg2 @ 0x20 (JEITA warm zone)
  adi,warm-cc1-current-percent:
    type: int
    enum: [20, 30, 40, 50, 60, 70, 80, 100]
    description: Warm-zone CC1 current as a percentage of IFCHG
      (ThmCfg2.ChgWarmCC1IFChg).

  adi,warm-batreg-offset-microvolt:
    type: int
    enum: [150000, 100000, 50000, 0]
    description: |
      Warm-zone battery regulation voltage reduction below ChgBatReg
      (ThmCfg2.ChgWarmBatReg). 0 means no reduction. Register-code order.

  adi,warm-cc2-current-percent:
    type: int
    enum: [20, 30, 40, 50, 60, 70, 80, 100]
    description: Warm-zone CC2 current as a percentage of IFCHG
      (ThmCfg2.ChgWarmCC2IFChg).

  # ThmCfg3 @ 0x21 (JEITA T1 thresholds)
  adi,jeita-t1-def-celsius:
    type: int
    enum: [-20, -15, -10, -5, 0, 5, 10, 15]
    description: JEITA T1 default threshold (ThmCfg3.ChgT1ThrDef).

  adi,jeita-t1-cc1-celsius:
    type: int
    enum: [-20, -15, -10, -5, 0, 5, 10, 15]
    description: JEITA T1 CC1 threshold (ThmCfg3.ChgT1ThrCC1).

  # ThmCfg4 @ 0x22 (JEITA T2 thresholds)
  adi,jeita-t2-def-celsius:
    type: int
    enum: [-10, -5, 0, 5, 10, 15, 20, 25]
    description: JEITA T2 default threshold (ThmCfg4.ChgT2ThrDef).

  adi,jeita-t2-cc1-celsius:
    type: int
    enum: [-10, -5, 0, 5, 10, 15, 20, 25]
    description: JEITA T2 CC1 threshold (ThmCfg4.ChgT2ThrCC1).

  # ThmCfg5 @ 0x23 (JEITA T3 thresholds)
  adi,jeita-t3-def-celsius:
    type: int
    enum: [20, 25, 30, 35, 40, 45, 50, 55]
    description: JEITA T3 default threshold (ThmCfg5.ChgT3ThrDef).

  adi,jeita-t3-cc1-celsius:
    type: int
    enum: [20, 25, 30, 35, 40, 45, 50, 55]
    description: JEITA T3 CC1 threshold (ThmCfg5.ChgT3ThrCC1).

  # ThmCfg6 @ 0x24 (JEITA T4 thresholds)
  adi,jeita-t4-def-celsius:
    type: int
    enum: [35, 40, 45, 50, 55, 60, 65, 70]
    description: JEITA T4 default threshold (ThmCfg6.ChgT4ThrDef).

  adi,jeita-t4-cc1-celsius:
    type: int
    enum: [35, 40, 45, 50, 55, 60, 65, 70]
    description: JEITA T4 CC1 threshold (ThmCfg6.ChgT4ThrCC1).

  # ThmCfg7 @ 0x25
  adi,thermal-limit-celsius:
    type: int
    enum: [40, 45, 50, 55, 60, 65, 70, 75, 80, 85, 90, 95, 100, 105, 110, 115]
    description: Charger die thermal limit (ThmCfg7.ChgThrmLim).

  adi,thermistor-pullup-ohms:
    type: int
    enum: [10000, 100000]
    description: THM internal pull-up selection (ThmCfg7.ThmPUSel).

  adi,thermistor-monitoring-mode:
    type: int
    enum: [0, 1, 2, 3, 4, 5, 6, 7]
    description: |
      Thermistor monitoring / JEITA control (ThmCfg7.ThmEn). Raw field value:
      0/4 disable monitoring; 1/2/3 enable JEITA-limited charging in
      cool+room / room+warm / cool+room+warm zones; 5/6/7 enable monitoring
      without JEITA charger effect.

  # ChgCtr1 @ 0x26
  adi,charge-fresh:
    type: boolean
    description: |
      On CHGIN insertion, force the device into the charger boot state even if
      VBAT is above the recharge threshold (ChgCtr1.ChgFresh).

  # ChgCtr2 @ 0x27
  adi,battery-pulldown:
    type: boolean
    description: Enable the BAT node pull-down resistor for battery-presence
      detection (ChgCtr2.BattPullDown).

  adi,force-precharge:
    type: boolean
    description: |
      Force the charger current to the precharge value; valid only when the
      charger is enabled (ChgCtr2.FrcPChg).

  # HrvBatCfg0 @ 0x28
  adi,harvester-mode:
    type: int
    enum: [0, 1, 2, 3]
    description: Harvester CHGOUT-to-SYS direct-path mode (HrvBatCfg0.HrvModCfg).

  adi,harvester-thermistor-mode:
    type: int
    enum: [0, 1, 2, 3]
    description: |
      Harvester periodic thermistor monitoring / charging zones
      (HrvBatCfg0.HrvThmEn).

  adi,harvester-thermistor-diode:
    type: boolean
    description: |
      Force the ideal CHGOUT-to-SYS diode active when charging from the
      harvester is inhibited by temperature (HrvBatCfg0.HrvThmDio).

  adi,harvester-free-mpc:
    type: boolean
    description: |
      Free MPC6/MPC7 from the harvester disable/wake functions so they can be
      used for other purposes (HrvBatCfg0.HrvFreeMPC).
```

## dts/bindings/dac/adi,ad5243.yaml
```yaml
# Copyright (c) 2026 Analog Devices Inc.
# SPDX-License-Identifier: Apache-2.0

description: |
  Analog Devices AD5243 dual-channel, 256-position I2C digital potentiometer.

compatible: "adi,ad5243"

include: adi,ad524x-base.yaml
```

## dts/bindings/dac/adi,ad5248.yaml
```yaml
# Copyright (c) 2026 Analog Devices Inc.
# SPDX-License-Identifier: Apache-2.0

description: |
  Analog Devices AD5248 dual-channel, 256-position I2C digital potentiometer.

compatible: "adi,ad5248"

include: adi,ad524x-base.yaml
```
